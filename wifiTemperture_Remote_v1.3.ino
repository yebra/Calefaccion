

/**  *
  WIFI MANAGER

  1. Versión
  Autor: Alberto Yebra
  Abril 2020
  Descripción:
  Sistema de calefacción encargado de:
  1- PANTALLA OLED con informacion de Temperatura
  2- Sensor de TEMPERATURA

  Todo sobre el ESP8266


    Conexión con Alexa
  Conexión a sensor DHT temperatura

  Versión 1.0

  1.1  Change Wifimanage library becasue solve problem when wifi switch off and system was not recovering properly after serveral hours without Router AP Wifi signal


  nota compilar con la opción
  auxmoESP 3.X.X: When using Arduino Core for ESP8266 v2.4.X, double check you are building the project with LwIP Variant set to "v1.4 Higher Bandwidth".
* */


#define __DEBUG__ 1

#include <DNSServer.h>

#include <Ticker.h> ///Librería para el parapadeo del led
#include "DHT.h"//Librería sensor de Temperatura DHT
#include <EEPROM.h> //Librería Acceso a la EEPROM
#include <ESP8266WiFi.h>

#include <ESPAsyncTCP.h>
#include <ESPAsyncWebServer.h>

AsyncWebServer server(80);

// Replace with your network credentials (STATION)
const char* ssid = "MOVISTAR_A2A0";
const char* password = "BE54316C434112149380";

const char* PARAM_INPUT_1 = "Status";
const char* PARAM_INPUT_2 = "humedity";

//AsyncWebServer server(80);
DNSServer dns;

#include <Adafruit_Sensor.h>
#include <SPI.h>
#include <Wire.h>

//PANTALLA OLED SSD1306
#include <Adafruit_GFX.h>
#include <Adafruit_SSD1306.h>

//Humedity PINES DHT22
#define DHTPIN 13 //(GPI1 13 - (D7) 
#define DHTTYPE DHT22


//OLED
#define SCREEN_WIDTH 128 // OLED display width, in pixels
#define SCREEN_HEIGHT 64 // OLED display height, in pixels
#define OLED_RESET -1 //LED_BUILTIN
// Initialize the OLED display using Wire library
Adafruit_SSD1306  display(SCREEN_WIDTH, SCREEN_HEIGHT, &Wire, OLED_RESET);  //D2=SDK  D1=SCK  As per labeling on NodeMCU

String webPage, notice;
//Variables que nos va a enviar el WifiManager para poder conocer cómo está configurado
int quemador = 3; //Valor 3 cuando no tenemos info
int calefaccion = 3;
int termostato = 3;

//Define la Struct que contiene la información que vamos a representar en la pantalla OLED
struct StructOLED {
  char cadenaTiempo[16];
  float temperatura;
  float consigna;
  boolean quemador;  //Indica si en estos momentos tenemos el quemador activado
  int Secuencia_Quemador; //Para realizar la animacion
  boolean termostato_pared; //Indica si el termostato de la pared está a ÓN
  boolean calefaccion; //Indica si tenemos la calefacción habilitada
  boolean mostrar_comunicacion; //Para indicar que hay un mensaje nuevo
  char comunicaciones[25]; //Informacion sobre el estado de las comunicaciones
};


StructOLED DatosOLED;



// Temporizador
unsigned long marcaTiempoDate = 0;
unsigned long tiempoRefreshDate = 1000;

// Variables almacena tiempo millis
int dias;
int horas;
int minutos;
int segundos;

// Cadena para almacenar texto formateado
char cadenaTiempo[16];

// Variable para recibir cuando se recibe peticiones http y mostrar en display que tiene comunicación
boolean estado_comunicacion;

DHT dht(DHTPIN, DHTTYPE);
////WiFiClient espClient;


//Variables información temporal
long lastMsg = 0;
long lastMsg2 = 0;

char msg[50];
int value = 0;


//IP address by default when you have connected to network
IPAddress local_IP(192, 168, 1, 5);
IPAddress gateway(192, 168, 1, 1);
IPAddress subnet(255, 255, 255, 0);


Ticker ticker;

// Pin LED azul
byte pinLed = 4;

//to take information about temperture and humedity
float h ;
float t ;

#define LOGO_HEIGHT   16
#define LOGO_WIDTH    16


static const unsigned char PROGMEM logo_bmp[] =
{ B00000000, B11000000,
  B00000001, B11000000,
  B00000001, B11000000,
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  B00000000, B00110000
};

static const unsigned char PROGMEM image_portada[8192] = {
  0xff, 0xff, 0xff, 0xff, 0xff, 0xff, 0xff, 0xff, 0xff, 0xff, 0xff, 0xff, 0xff, 0xff, 0xff, 0xff,
  0xff, 0xff, 0xff, 0xff, 0xff, 0xff, 0xff, 0xff, 0xff, 0xff, 0xff, 0xff, 0xff, 0xff, 0xff, 0xff,
  0xff, 0xff, 0xff, 0xff, 0xff, 0xff, 0xff, 0xff, 0xff, 0xff, 0xff, 0xff, 0xff, 0xff, 0xff, 0xff,
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  0xff, 0xff, 0xff, 0xff, 0xff, 0xff, 0xff, 0xff, 0xff, 0xff, 0xff, 0xff, 0xff, 0xff, 0xff, 0xff
};

static const unsigned char PROGMEM image_data_CalefaccionOFF[1024] = {
  0x01, 0xff, 0xfe, 0x00, 0x00, 0x00, 0x00, 0x00, 0x01, 0x00, 0x02, 0x0f, 0xf0, 0x1f, 0xc3, 0xf8,
  0x01, 0x00, 0x02, 0x0f, 0xf0, 0x1f, 0xc3, 0xf8, 0x01, 0x00, 0x02, 0x30, 0x0c, 0x60, 0x0c, 0x00,
  0x01, 0x00, 0x02, 0x30, 0x0c, 0x60, 0x0c, 0x00, 0x01, 0x00, 0x02, 0x30, 0x0c, 0x60, 0x0c, 0x00,
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  0x01, 0x00, 0x02, 0x0f, 0xf0, 0x60, 0x0c, 0x00, 0x01, 0xff, 0xfe, 0x00, 0x00, 0x00, 0x00, 0x00
};
static const unsigned char PROGMEM image_data_CalefaccionON[1024] = {
  0x01, 0xff, 0xfe, 0x00, 0x00, 0x00, 0x00, 0x00, 0x01, 0x00, 0x02, 0x03, 0xfc, 0x0c, 0x00, 0xc0,
  0x01, 0x7f, 0xfa, 0x03, 0xfc, 0x0c, 0x00, 0xc0, 0x01, 0x7f, 0xfa, 0x0c, 0x03, 0x0f, 0x00, 0xc0,
  0x01, 0x7f, 0xfa, 0x0c, 0x03, 0x0f, 0x00, 0xc0, 0x01, 0x7f, 0xfa, 0x0c, 0x03, 0x0c, 0xc0, 0xc0,
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  0x01, 0x00, 0x02, 0x03, 0xfc, 0x0c, 0x00, 0xc0, 0x01, 0xff, 0xfe, 0x00, 0x00, 0x00, 0x00, 0x00
};

static const unsigned char PROGMEM image_data_Quemador1[1024] = {
  0x00, 0x00, 0xfc, 0x00, 0x0e, 0x00, 0x00, 0x00, 0x00, 0x00, 0x87, 0x3f, 0x73, 0x00, 0x00, 0x00,
  0x00, 0x00, 0x81, 0x61, 0x41, 0xbe, 0x00, 0x00, 0x00, 0x00, 0x61, 0xc1, 0x40, 0xa3, 0x00, 0x00,
  0x00, 0x06, 0x60, 0x01, 0xc0, 0xe0, 0xc0, 0x00, 0x00, 0x05, 0xc0, 0x00, 0x00, 0x00, 0x40, 0x00,
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  0x00, 0x00, 0x1f, 0xed, 0xa1, 0x80, 0x00, 0x00, 0x00, 0x00, 0x0f, 0xc7, 0x1f, 0x00, 0x00, 0x00
};
static const unsigned char PROGMEM image_data_Quemador2[1024] = {
  0x00, 0x00, 0xf0, 0x03, 0x00, 0x00, 0x00, 0x00, 0x00, 0x00, 0x50, 0x03, 0xf0, 0x00, 0x00, 0x00,
  0x00, 0x01, 0x90, 0x73, 0x70, 0x07, 0x80, 0x00, 0x00, 0x06, 0x70, 0xd1, 0x78, 0x07, 0x80, 0x00,
  0x00, 0x06, 0x78, 0x93, 0xcc, 0x05, 0x80, 0x00, 0x00, 0x05, 0xc8, 0xb6, 0x0c, 0x1c, 0x80, 0x00,
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  0x00, 0x03, 0xef, 0xed, 0xb0, 0x00, 0x00, 0x00, 0x00, 0x00, 0x3f, 0xc7, 0x00, 0x00, 0x00, 0x00
};

static const unsigned char PROGMEM   image_data_TermostatoPared [] = {
  0x1f, 0xff, 0xff, 0xff, 0xff, 0xff, 0xff, 0xfc, 0x10, 0x00, 0x00, 0x00, 0x00, 0x00, 0x00, 0x04,
  0x10, 0xf8, 0x04, 0x70, 0x00, 0x3f, 0xf8, 0x04, 0x10, 0x04, 0x04, 0x50, 0x00, 0x40, 0x04, 0x04,
  0x10, 0x04, 0x04, 0x70, 0x00, 0x43, 0x84, 0x04, 0x10, 0x04, 0x04, 0x00, 0x00, 0x40, 0x04, 0x04,
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  0x10, 0x00, 0x00, 0x00, 0x00, 0x00, 0x00, 0x04, 0x1f, 0xff, 0xff, 0xff, 0xff, 0xff, 0xff, 0xfc
};



unsigned long previousMillis = 0;
unsigned long interval = 30000;

void setup()
{
  Serial.begin(115200);


#ifdef __DEBUG__
  Serial.println("Initializing OLED Display");
  Serial.begin(115200);
  Serial.println("");
#endif
  // Modo del pin
  pinMode(pinLed, OUTPUT);

  // Empezamos el temporizador que hará parpadear el LED
  ticker.attach(0.2, parpadeoLed);


  // Connect to Wi - Fi network with SSID and password
  Serial.print("Connecting to ");
  Serial.println(ssid);
  //WiFi.mode(WIFI_STA);

  WiFi.config(local_IP, gateway, subnet);
  if (!WiFi.config(local_IP, gateway, subnet)) {
    Serial.println("STA Failed to configure");
  }

  WiFi.begin(ssid, password);
  if (WiFi.waitForConnectResult() != WL_CONNECTED) {
    Serial.println("WiFi Failed!");
    return;
  }
  WiFi.setAutoReconnect(true);
  WiFi.persistent(true);

  // Print local IP address and start web server
  Serial.println("");
  Serial.println("WiFi connected.");
  Serial.println("IP address: ");
  Serial.print("ESP IP Address: http://");
  Serial.println(WiFi.localIP());
  Serial.print("RRSI: ");
  Serial.println(WiFi.RSSI());




#ifdef __DEBUG__
  Serial.println("Ya estás conectado");
#endif


  // Eliminamos el temporizador
  ticker.detach();

  // Apagamos el LED
  //digitalWrite(pinLed, HIGH);

  dht.begin();


  // Setting the ESP as an access point
#ifdef __DEBUG__
  Serial.print("Setting STA ");
#endif
  // Remove the password parameter, if you want the AP (Access Point) to be open



  // SSD1306_SWITCHCAPVCC = generate display voltage from 3.3V internally
  if (!display.begin(SSD1306_SWITCHCAPVCC, 0x3C)) { // Address 0x3C for 128x32
    Serial.println(F("SSD1306 allocation failed"));
    for (;;); // Don't proceed, loop forever
  }

  display.clearDisplay();
  display.invertDisplay(true);
  display.fillScreen(0);         //Limpiamos la pantalla
  display.drawBitmap(0, 0, image_portada, 128, 64, SSD1306_WHITE);
  display.display();
  delay(4000);


  //TEXTO CON FUENTE PREDETERMINADA
  display.invertDisplay(false);
  display.fillScreen(0);         //Limpiamos la pantalla

  display.setFont();             //Fuente por defecto -si no la hemos cambiado no es necesario seleccionarla

  display.setTextSize(1);
  display.setTextColor(1, 0);
  display.setCursor(0, 0);
  display.println("REMOTO - TE");
  display.setTextSize(2);
  display.print("IKER-ANDER");

  display.setTextSize(2);
  display.setTextColor(1, 0);    //Color invertido
  display.setCursor(0, 32);
  display.print("Iniciando...");
  display.display();             //Refrescamos la pantalla para visualizarlo
  Serial.println("Iniciando OLED");
  delay(4000);

  h = dht.readHumidity();
  t = dht.readTemperature();

  server.on("/temperature", HTTP_GET, [](AsyncWebServerRequest * request) {
    // Lambda body implementation
    String inputMessage1;

    // GET input1 value on <ESP_IP>/temperature?Status=111;
    if (request->hasParam(PARAM_INPUT_1)) {
      inputMessage1 = request->getParam(PARAM_INPUT_1)->value();
    }

    String noticeC = "";
    String noticeQ = "";
    String noticeT = "";

    noticeT  = inputMessage1.substring(0, 1);
    noticeC  = inputMessage1.substring(1, 2);
    noticeQ  = inputMessage1.substring(2, 3);

   
    if (noticeC.toInt() == 0) {
      //Calefaccion apagada
      DatosOLED.calefaccion = 0;
    } else {
      //Calefaccion encendida
      DatosOLED.calefaccion = 1;
    }

    if (noticeT.toInt()  == 0) {
      //termostato apagada
      DatosOLED.termostato_pared = 0;
    } else {
      //Calefaccion encendida
      DatosOLED.termostato_pared = 1;
    }


    if (noticeQ.toInt() == 0) {
      //Quemador apagada
      DatosOLED.quemador = 0;
    } else {
      //Quemador encendida
      DatosOLED.quemador = 1;
    }
    Serial.println("Peticion! http Temperature\n");
    //OLED_parpadeo();

    request->send(200, "text/plain", String(t, 3).c_str());


  });

   server.begin();
}

void loop() {
  ESP.wdtFeed(); // feeds the dog
  delay(0);

  // Serial.println("Status WIFI...");
  // Serial.println(WiFi.status());

  /*
    Value  Constant  Meaning
    0 WL_IDLE_STATUS  temporary status assigned when WiFi.begin() is called
    1 WL_NO_SSID_AVAIL   when no SSID are available
    2 WL_SCAN_COMPLETED scan networks is completed
    3 WL_CONNECTED  when connected to a WiFi network
    4 WL_CONNECT_FAILED when the connection fails for all the attempts
    5 WL_CONNECTION_LOST  when the connection is lost
    6 WL_DISCONNECTED when disconnected from a network
  */


  //  Serial.print("RRSI: ");
  //  Serial.println(WiFi.RSSI());

  // Protección overflow
  if (millis() < marcaTiempoDate) {
    marcaTiempoDate = millis();
  }


  // Comprobar is hay que actualizar temperatura
  if (millis() - marcaTiempoDate >= tiempoRefreshDate)
  {
    // Actualizar variables de tiempo
    millisToTiempo(millis());
    // Componer cadena con la información del tiempo formateada
    //sprintf(cadenaTiempo, "%02d:%02d:%02d:%02d", dias, horas, minutos, segundos);

    // Marca de tiempo
    marcaTiempoDate = millis();
  }

  long now = millis();

  unsigned long currentMillis = millis();
  
  // if WiFi is down, try reconnecting every CHECK_WIFI_TIME seconds
  if ((WiFi.status() != WL_CONNECTED) && (currentMillis - previousMillis >=interval)) {
    Serial.print(millis());
    Serial.println("Reconnecting to WiFi...");
    WiFi.disconnect();
    WiFi.begin(ssid, password);
    Serial.println(WiFi.localIP());
    //Alternatively, you can restart your board
    //ESP.restart();
    Serial.println(WiFi.RSSI());
    previousMillis = currentMillis;
  }










  // if WiFi is down, try reconnecting
  if (now - lastMsg2 >= 400000) {
    Serial.print("Check if the connection is ok Status");
    Serial.print(WiFi.status() );
    Serial.print("The IP adress: ");
    Serial.println(WiFi.localIP());

    if (WiFi.status() != WL_CONNECTED) {
      WiFi.disconnect();
      Serial.println(" Disconnecting!");
      delay(100);
      WiFi.begin(ssid, password);
      if (WiFi.waitForConnectResult() != WL_CONNECTED) {
        Serial.println(" WiFi Failed!");
        return;
      }
      WiFi.reconnect();
      Serial.println(" Reconecting!");
    }

    lastMsg2 = now;

  }



  if (now - lastMsg > 4000) {
    lastMsg = now;
    ++value;
    //snprintf (msg, 75, "%d", t);
    h = dht.readHumidity();
    t = dht.readTemperature();
    if (isnan(h) || isnan(t)) {
      Serial.println("Error en la lectura del sensor!\n");
      return;
    }

    sprintf(DatosOLED.cadenaTiempo, cadenaTiempo);
    DatosOLED.temperatura = t;
    display.display();
  }
  OLED_print();
  delay(2000);
}

/*
  Función que convierte millis() a segundos, minutos, horas y días
  Almacena la información en variables globales
*/
void millisToTiempo(unsigned long valMillis) {
  // Se obtienen los segundos
  valMillis = valMillis / 1000;

  segundos = valMillis % 60; // se divide entre segundos por minuto y te quedas con el resto
  minutos = valMillis / 60; // Se convierte a minutos
  minutos = minutos % 60; // se divide entre minutos por hora y te quedas con el resto
  horas = (valMillis / 60) / 60; // Se convierte en horas
  horas = horas % 24; // se divide entre horas al día y te quedas con el resto
  dias = ((valMillis / 60) / 60) / 24; // Se convierte en días
#ifdef __DEBUG__

#endif
}


//OLED function
void OLED_print() {

  //Serial.print("\n OLED:Secuencia_QUEMADOR:");
  //Serial.print(DatosOLED.Secuencia_Quemador);

  display.clearDisplay();
  display.fillScreen(0);         //Limpiamos la pantalla

  // Dibujar texto tiempo
  DatosOLED.Secuencia_Quemador = DatosOLED.Secuencia_Quemador + 1;
  if (DatosOLED.Secuencia_Quemador > 3) {
    DatosOLED.Secuencia_Quemador = 0;
  }
  //SE muestra el menaje una vez recibida una comunicación, después ya el funcionamiento de todo
  //Bloque 1
  display.setTextSize(1);
  display.setTextColor(SSD1306_WHITE);
  display.setCursor(0, 0);
  display.println(DatosOLED.cadenaTiempo);

  //Bloque 2
  display.setTextSize(2);
  display.setCursor(0, 16);
  display.println(DatosOLED.temperatura, 1);
  //display.cp437(true);
  //display.write(167);
  //display.println("C");

  // Bloque 3
  display.setTextSize(2);
  display.setCursor(70, 0);
  display.println(DatosOLED.consigna, 1);
  //display.cp437(true);
  //display.write(167);
  //display.println("C");

  // Bloque 4
  //Serial.print("\n OLED:Quemador:");
  //Serial.print(DatosOLED.quemador);

  if (DatosOLED.quemador == 1) {
    if (DatosOLED.Secuencia_Quemador == 1) {
      display.drawBitmap(64, 16, image_data_Quemador1, 64, 16, SSD1306_WHITE);
    } else {
      DatosOLED.Secuencia_Quemador = 0;
      display.drawBitmap(64, 16, image_data_Quemador2, 64, 16, SSD1306_WHITE);
    }
  }

  // Bloque 5
  //Serial.println("DatosOLED.termostato_pared");
  //Serial.println(DatosOLED.termostato_pared);

  //Serial.print("\n OLED:Termostato:");
  //Serial.print(DatosEE.E_Termostato);

  if (DatosOLED.termostato_pared == 1) {
    //display.fillCircle(16,48 , 8, SSD1306_WHITE);
    display.drawBitmap(0, 40, image_data_TermostatoPared, 64, 16, SSD1306_WHITE);
  }//else display.drawCircle(16, 48, 8, SSD1306_WHITE);

  // Bloque 6

  //Serial.print("\n OLED:Calefaccion:");
  //Serial.print(DatosOLED.calefaccion);

  if (DatosOLED.calefaccion == 1) {
    display.drawBitmap(64, 40, image_data_CalefaccionON, 64, 16, SSD1306_WHITE);
  } else display.drawBitmap(64, 40, image_data_CalefaccionOFF, 64, 16, SSD1306_WHITE);
  //display.drawCircle(96, 64, 8, SSD1306_WHITE);
  // Bloque 7
  display.setTextSize(1);
  display.setCursor(0, 56);
  display.println(DatosOLED.comunicaciones);
  //Limpiamos el buffer una vez mostrada una vez mostrada en el display
  sprintf(DatosOLED.comunicaciones, "");

  display.display();
}
void OLED_parpadeo() {
  //Función para mostrar un parpadeo en esquina derecha cuando se recibe un dato
  estado_comunicacion = !estado_comunicacion;
  if (estado_comunicacion = 1) {
    display.drawCircle(123, 5, 5, SSD1306_WHITE);
    display.fillCircle(123, 5, 5, SSD1306_WHITE);
  } else {
    display.drawCircle(123, 5, 5, SSD1306_WHITE);
  }
  display.display();

}


void parpadeoLed() {
  // Cambiar de estado el LED
  byte estado = digitalRead(pinLed);
  digitalWrite(pinLed, !estado);
}
